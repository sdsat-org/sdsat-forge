## boards/spacemit/muse-card/asterinas.its
```
/dts-v1/;
/ {
    description = "MUSE-Card Asterinas and BusyBox";
    #address-cells = <2>;
    images {
        kernel {
            description = "Asterinas";
            data = /incbin/("asterinas.bin.gz");
            type = "kernel";
            arch = "riscv";
            os = "linux";
            compression = "gzip";
            load = <0x0 0x400000>;
            entry = <0x0 0x400000>;
            hash-1 { algo = "crc32"; };
        };
        ramdisk {
            description = "BusyBox initramfs";
            data = /incbin/("initramfs.cpio");
            type = "ramdisk";
            arch = "riscv";
            os = "linux";
            compression = "none";
            load = <0x0 0x2000000>;
            hash-1 { algo = "crc32"; };
        };
        fdt {
            description = "MUSE-Card";
            data = /incbin/("asterinas.dtb");
            type = "flat_dt";
            arch = "riscv";
            compression = "none";
            load = <0x0 0x3000000>;
            hash-1 { algo = "crc32"; };
        };
    };
    configurations {
        default = "muse-card";
        muse-card {
            description = "k1-x_MUSE-Card";
            kernel = "kernel";
            ramdisk = "ramdisk";
            fdt = "fdt";
        };
    };
};
```

## boards/spacemit/muse-card/fw_dynamic.its
```
/dts-v1/;
/ {
    description = "RustSBI dynamic firmware";
    #address-cells = <2>;
    images {
        opensbi {
            description = "RustSBI";
            data = /incbin/("rustsbi.bin");
            type = "firmware";
            arch = "riscv";
            os = "opensbi";
            compression = "none";
            load = <0x0 0x10000>;
            entry = <0x0 0x10000>;
            hash-1 { algo = "crc32"; };
        };
    };
    configurations {
        default = "config_1";
        config_1 {
            description = "MUSE-Card RustSBI";
            firmware = "opensbi";
        };
    };
};
```

## boards/spacemit/muse-card/rustsbi-usb-muse-card.its
```
/dts-v1/;
/ {
    description = "RustSBI and official U-Boot, MUSE-Card USB RAM boot";
    #address-cells = <2>;
    images {
        opensbi {
            description = "RustSBI";
            data = /incbin/("rustsbi.bin");
            type = "firmware";
            os = "opensbi";
            arch = "riscv";
            compression = "none";
            load = <0 0x10000>;
            entry = <0 0x10000>;
            hash-1 { algo = "crc32"; };
        };
        uboot {
            description = "Official K1 U-Boot";
            data = /incbin/("u-boot-nodtb.bin");
            type = "standalone";
            os = "U-Boot";
            arch = "riscv";
            compression = "none";
            load = <0 0x00200000>;
            entry = <0 0x00200000>;
            hash-1 { algo = "crc32"; };
        };
        fdt {
            description = "k1-x_MUSE-Card";
            data = /incbin/("u-boot-muse-card.dtb");
            type = "flat_dt";
            compression = "none";
            load = <0 0x01000000>;
            hash-1 { algo = "crc32"; };
        };
    };
    configurations {
        default = "conf_muse_card";
        conf_muse_card {
            description = "k1-x_MUSE-Card";
            firmware = "opensbi";
            loadables = "uboot";
            fdt = "fdt";
        };
    };
};
```

## boards/spacemit/muse-card/uboot-minimal.defconfig
```kconfig
CONFIG_RISCV=y
CONFIG_SYS_TEXT_BASE=0x00200000
CONFIG_SYS_MALLOC_LEN=0x1000000
CONFIG_NR_DRAM_BANKS=2
CONFIG_SPL_LDSCRIPT="arch/$(ARCH)/cpu/x60/u-boot-spl.lds"
CONFIG_ENV_SIZE=0x4000
CONFIG_ENV_OFFSET=0x60000
CONFIG_DM_GPIO=y
CONFIG_SPL_DM_SPI=y
CONFIG_DEFAULT_DEVICE_TREE="k1-x_MUSE-Card"
CONFIG_SPL_TEXT_BASE=0xC0801000
CONFIG_SPL_MMC=y
CONFIG_SPL_DRIVERS_MISC=y
CONFIG_SPL_SYS_MALLOC_F_LEN=0x5000
CONFIG_SPL_SIZE_LIMIT=0x34f00
CONFIG_SPL=y
CONFIG_SPL_SPI_FLASH_SUPPORT=y
CONFIG_SPL_SPI=y
CONFIG_SYS_LOAD_ADDR=0x200000
# CONFIG_AHCI is not set
CONFIG_TARGET_SPACEMIT_K1X=y
CONFIG_SPL_OPENSBI_LOAD_ADDR=0x0
CONFIG_SPACEMIT_UBOOT_FIT_SOURCE="board/spacemit/k1-x/configs/uboot_muse_card.its"
# CONFIG_SPACEMIT_SD_AUTO_FLASH is not set
# CONFIG_SPACEMIT_SD_PARTITION_RESIZE is not set
CONFIG_K1_X_BOARD_ASIC=y
CONFIG_ARCH_RV64I=y
CONFIG_RISCV_SMODE=y
# CONFIG_SPL_SMP is not set
CONFIG_LOCALVERSION="spacemit"
CONFIG_ENV_VARS_UBOOT_CONFIG=y
CONFIG_HAS_CUSTOM_SYS_INIT_SP_ADDR=y
CONFIG_CUSTOM_SYS_INIT_SP_ADDR=0x1000000
CONFIG_STACK_SIZE=0x100000
CONFIG_FIT=y
CONFIG_SPL_FIT_SIGNATURE=y
CONFIG_SPL_LOAD_FIT_ADDRESS=0x08000000
# CONFIG_BOOTSTD is not set
CONFIG_LEGACY_IMAGE_FORMAT=y
CONFIG_SUPPORT_RAW_INITRD=y
CONFIG_OF_BOARD_SETUP=y
CONFIG_BOOTDELAY=3
CONFIG_AUTOBOOT_KEYED=y
CONFIG_AUTOBOOT_STOP_STR="s"
CONFIG_USE_BOOTCOMMAND=y
CONFIG_BOOTCOMMAND="bootm 0x08000000"
CONFIG_SPL_LOGLEVEL=1
CONFIG_CONSOLE_MUX=y
CONFIG_SYS_STDIO_DEREGISTER=y
# CONFIG_SYS_DEVICE_NULLDEV is not set
CONFIG_DISPLAY_CPUINFO=y
CONFIG_DISPLAY_BOARDINFO=y
CONFIG_EVENT=y
CONFIG_EVENT_DYNAMIC=y
CONFIG_MISC_INIT_R=y
CONFIG_SPL_MAX_SIZE=0x33000
CONFIG_SPL_PAD_TO=0x0
CONFIG_SPL_BSS_START_ADDR=0xC0837000
CONFIG_SPL_BSS_MAX_SIZE=0x2000
CONFIG_SPL_BOARD_INIT=y
# CONFIG_SPL_RAW_IMAGE_SUPPORT is not set
# CONFIG_SPL_SHARES_INIT_SP_ADDR is not set
CONFIG_SPL_STACK=0xC0840000
CONFIG_SYS_SPL_MALLOC=y
CONFIG_HAS_CUSTOM_SPL_MALLOC_START=y
CONFIG_CUSTOM_SYS_SPL_MALLOC_ADDR=0x4000000
CONFIG_SYS_SPL_MALLOC_SIZE=0x2000000
CONFIG_SYS_MMCSD_RAW_MODE_U_BOOT_USE_PARTITION=y
CONFIG_SPL_ENV_SUPPORT=y
CONFIG_SPL_I2C=y
CONFIG_SPL_MMC_WRITE=y
CONFIG_SPL_MTD_SUPPORT=y
CONFIG_SPL_NAND_DRIVERS=y
CONFIG_SPL_NAND_SIMPLE=y
CONFIG_SPL_DM_SPI_FLASH=y
CONFIG_SPL_DM_RESET=y
CONFIG_SPL_POWER=y
# CONFIG_SPL_RAM_SUPPORT is not set
# CONFIG_SPL_SPI_FLASH_TINY is not set
CONFIG_SPL_SPI_FLASH_MTD=y
CONFIG_SPL_MTD_LOAD=y
CONFIG_SYS_LOAD_IMAGE_PARTITION_NAME="opensbi"
CONFIG_SYS_LOAD_IMAGE_SEC_PARTITION=y
CONFIG_SYS_LOAD_IMAGE_SEC_PARTITION_NAME="uboot"
CONFIG_SPL_USB_GADGET=y
CONFIG_SPL_FASTBOOT_LOAD=y
CONFIG_SPL_USB_SDP_SUPPORT=y
CONFIG_SPL_OPENSBI_SCRATCH_OPTIONS=0x0
CONFIG_HUSH_PARSER=y
# CONFIG_CMD_CPU is not set
CONFIG_CMD_TLV_EEPROM=y
CONFIG_CMD_TLV_CUSTOM=y
CONFIG_SYS_BOOTM_LEN=0x10000000
# CONFIG_CMD_LZMADEC is not set
# CONFIG_CMD_UNLZ4 is not set
# CONFIG_CMD_FLASH is not set
CONFIG_CMD_GPT=y
CONFIG_CMD_GPT_RENAME=y
CONFIG_CMD_I2C=y
CONFIG_CMD_MMC=y
CONFIG_CMD_BKOPS_ENABLE=y
CONFIG_CMD_MTD=y
CONFIG_CMD_PART=y
# CONFIG_CMD_PCI is not set
# CONFIG_CMD_SCSI is not set
CONFIG_CMD_WDT=y
CONFIG_CMD_FS_UUID=y
CONFIG_CMD_MTDPARTS=y
CONFIG_CMD_MTDPARTS_SPREAD=y
CONFIG_CMD_MTDPARTS_SHOW_NET_SIZES=y
CONFIG_MTDIDS_DEFAULT="nor0=d420c000.spi-0"
CONFIG_MTDPARTS_DEFAULT="d420c000.spi-0:64K@0(bootinfo),64K@64K(private),256K@128K(fsbl),64K@384K(env),192K@448K(opensbi),-@640K(uboot)"
CONFIG_SPACEMIT_FLASH=y
CONFIG_SPL_FASTBOOT=y
CONFIG_ENABLE_SET_NUM_PART_SEARCH=y
CONFIG_PARTITION_TYPE_GUID=y
CONFIG_MULTI_DTB_FIT=y
CONFIG_ENV_OVERWRITE=y
CONFIG_ENV_IS_NOWHERE=y
CONFIG_ENV_IS_IN_MMC=y
CONFIG_SYS_MMC_ENV_DEV=1
# CONFIG_SPL_ENV_IS_NOWHERE is not set
# CONFIG_NET is not set
CONFIG_REGMAP=y
CONFIG_DEVRES=y
# CONFIG_SCSI_AHCI is not set
CONFIG_SPL_CLK=y
CONFIG_SPL_CLK_CCF=y
CONFIG_SPACEMIT_K1X_CCU=y
CONFIG_DYNAMIC_DDR_CLK_FREQ=y
CONFIG_DMA=y
CONFIG_DMA_CHANNELS=y
CONFIG_USB_FUNCTION_FASTBOOT=y
CONFIG_FASTBOOT_BUF_ADDR=0x08000000
CONFIG_FASTBOOT_BUF_SIZE=0x10000000
CONFIG_FASTBOOT_FLASH=y
CONFIG_FASTBOOT_MULTI_FLASH_OPTION=y
CONFIG_FASTBOOT_FLASH_MMC_DEV=0
CONFIG_FASTBOOT_MMC_BOOT_SUPPORT=y
CONFIG_FASTBOOT_MMC_BOOT1_NAME="fsbl"
CONFIG_FASTBOOT_MMC_BOOT2_NAME="fsbl_1"
CONFIG_FASTBOOT_CMD_OEM_READ=y
CONFIG_FASTBOOT_SUPPORT_BLOCK_DEV=y
CONFIG_FASTBOOT_SUPPORT_BLOCK_DEV_NAME="mmc"
CONFIG_FASTBOOT_CMD_OEM_CONFIG_ACCESS=y
CONFIG_FASTBOOT_CMD_OEM_ERASE=y
CONFIG_FASTBOOT_CMD_OEM_ENV_ACCESS=y
CONFIG_SPL_FASTBOOT_CMD_OEM_ENV_ACCESS=y
CONFIG_K1X_GPIO=y
CONFIG_DM_I2C=y
# CONFIG_SPL_DM_I2C is not set
CONFIG_SPL_SYS_I2C_LEGACY=y
CONFIG_SYS_I2C_SPACEMIT=y
CONFIG_SPL_SYS_I2C_SPACEMIT=y
CONFIG_I2C_MUX=y
# CONFIG_INPUT is not set
CONFIG_DM_KEYBOARD=y
CONFIG_MISC=y
CONFIG_I2C_EEPROM=y
CONFIG_SPACEMIT_K1X_EFUSE=y
CONFIG_SPL_SPACEMIT_K1X_EFUSE=y
CONFIG_MMC=y
CONFIG_SUPPORT_EMMC_BOOT=y
CONFIG_MMC_IO_VOLTAGE=y
CONFIG_MMC_UHS_SUPPORT=y
CONFIG_MMC_HS400_ES_SUPPORT=y
CONFIG_SPL_MMC_HS400_ES_SUPPORT=y
CONFIG_MMC_HS400_SUPPORT=y
CONFIG_SPL_MMC_HS400_SUPPORT=y
# CONFIG_MMC_VERBOSE is not set
CONFIG_MMC_SDHCI=y
CONFIG_MMC_SDHCI_ADMA=y
CONFIG_SPL_MMC_SDHCI_ADMA=y
CONFIG_MMC_SDHCI_K1X=y
CONFIG_DM_MTD=y
# CONFIG_MTD_NOR_FLASH is not set
# CONFIG_CFI_FLASH is not set
CONFIG_USE_SYS_MAX_FLASH_BANKS=y
CONFIG_SPI_FLASH_GIGADEVICE=y
CONFIG_SPI_FLASH_WINBOND=y
CONFIG_SPI_FLASH_FM=y
# CONFIG_SPI_FLASH_USE_4K_SECTORS is not set
CONFIG_SPI_FLASH_MTD=y
# CONFIG_NVME is not set
# CONFIG_PCI is not set
CONFIG_PHY=y
CONFIG_PHY_SPACEMIT_K1X_USB2=y
CONFIG_PHY_SPACEMIT_K1X_COMBPHY=y
CONFIG_PINCTRL=y
CONFIG_PINCTRL_SINGLE=y
CONFIG_POWER_DOMAIN=y
CONFIG_K1X_POWER_DOMAIN=y
CONFIG_DM_PMIC=y
# CONFIG_SPL_DM_PMIC is not set
CONFIG_PMIC_SPM8XX=y
CONFIG_DM_REGULATOR=y
CONFIG_DM_REGULATOR_SPM8XX=y
CONFIG_DM_REGULATOR_SPACEMIT_HUB=y
CONFIG_SPL_SPACEMIT_POWER=y
CONFIG_DM_RESET=y
CONFIG_RESET_SPACEMIT_K1X=y
# CONFIG_SCSI is not set
# CONFIG_DM_SCSI is not set
CONFIG_SYS_NS16550_IER=0x40
# CONFIG_HTIF_CONSOLE is not set
# CONFIG_SIFIVE_SERIAL is not set
CONFIG_SPI=y
CONFIG_K1X_QSPI=y
CONFIG_K1X_SPI=y
# CONFIG_SYSRESET_SBI is not set
# CONFIG_SYSRESET_SYSCON is not set
CONFIG_SYSRESET_WATCHDOG=y
CONFIG_TIMER_EARLY=y
CONFIG_USB=y
CONFIG_TYPEC_HUSB239=y
CONFIG_USB_GADGET=y
CONFIG_USB_GADGET_VENDOR_NUM=0x361C
CONFIG_USB_GADGET_PRODUCT_NUM=0x1001
CONFIG_USB2_K1X_CI=y
# CONFIG_USB_SET_SERIAL_NUMBER is not set
CONFIG_SYS_WHITE_ON_BLACK=y
CONFIG_I2C_EDID=y
# CONFIG_VIRTIO_MMIO is not set
CONFIG_WDT_SPACEMIT=y
CONFIG_WDT_PMIC_SPACEMIT=y
CONFIG_EXT4_WRITE=y
CONFIG_FAT_WRITE=y
CONFIG_UBIFS_SILENCE_MSG=y
CONFIG_IMAGE_SPARSE_TRANSFER_BLK_NUM=0x3000
CONFIG_PRINT_TIMESTAMP=y
# CONFIG_SPL_USE_TINY_PRINTF is not set
CONFIG_REGEX=y
# CONFIG_RSA is not set
# CONFIG_SPL_SHA1 is not set
# CONFIG_SPL_SHA256 is not set
CONFIG_ZLIB_UNCOMPRESS=y
CONFIG_VPL_LZMA=y
CONFIG_SPL_LZO=y
# CONFIG_EFI_LOADER is not set
```
